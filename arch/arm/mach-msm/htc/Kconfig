## arch/arm/mach-msm/htc/Kconfig
```kconfig
config MACH_HTC
	bool "HTC"

config MACH_HTC_MSM7X27
	select MACH_HTC
	bool "HTC MSM7X27"

config MACH_MSM7X27_MARVEL
	depends on ARCH_MSM7X27
	depends on !MSM_STACKED_MEMORY
	select MACH_HTC_MSM7X27
	bool "MSM7x27 Marvel"
	help
	  Support for the HTC Marvel board

config MACH_MSM7X27_LIBERTY
	depends on ARCH_MSM7X27
	depends on !MSM_STACKED_MEMORY
	select MACH_HTC_MSM7X27
	bool "MSM7x27 Liberty"
	help
	  Support for the HTC Liberty board
```
